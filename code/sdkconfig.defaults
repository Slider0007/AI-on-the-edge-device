## code/sdkconfig.defaults
```kconfig
##################################################
# Application specific and global configuration
# Edit this file instead of sdkconfig.{board_type}!
# After editing make sure to explicitly delete
# sdkconfig.{board_type} to apply your changes!
##################################################

#
# Bootloader config
#
CONFIG_BOOTLOADER_COMPILER_OPTIMIZATION_SIZE=y
CONFIG_BOOTLOADER_LOG_LEVEL_ERROR=y
CONFIG_BOOTLOADER_LOG_LEVEL=1


#
# Example Connection Configuration
#
CONFIG_EXAMPLE_CONNECT_WIFI=n
CONFIG_EXAMPLE_CONNECT_ETHERNET=n


#
# ESP-NN
#
CONFIG_NN_OPTIMIZED=y
CONFIG_NN_OPTIMIZATIONS=1


#
# Compiler options
#
CONFIG_COMPILER_OPTIMIZATION_SIZE=y
CONFIG_COMPILER_OPTIMIZATION_ASSERTIONS_SILENT=y
CONFIG_COMPILER_OPTIMIZATION_CHECKS_SILENT=y


#
# RMT Configuration
#
CONFIG_RMT_SUPPRESS_DEPRECATE_WARN=y
CONFIG_RMT_ISR_IRAM_SAFE=y

#
# ESP-TLS
#
CONFIG_ESP_TLS_USING_MBEDTLS=y
CONFIG_MBEDTLS_EXTERNAL_MEM_ALLOC=y


#
# ADC Calibration Configurations
#
CONFIG_ADC_CAL_EFUSE_TP_ENABLE=n
CONFIG_ADC_CAL_EFUSE_VREF_ENABLE=n
CONFIG_ADC_CAL_LUT_ENABLE=n

CONFIG_ADC_CALI_EFUSE_TP_ENABLE=n
CONFIG_ADC_CALI_EFUSE_VREF_ENABLE=n
CONFIG_ADC_CALI_LUT_ENABLE=n

CONFIG_ADC_DISABLE_DAC_OUTPUT=y


#
# Ethernet
#
CONFIG_ETH_USE_SPI_ETHERNET=n

#
# HTTP client
#
CONFIG_ESP_HTTP_CLIENT_ENABLE_HTTPS=y
CONFIG_ESP_HTTP_CLIENT_ENABLE_BASIC_AUTH=y

#
# HTTP Server
#
CONFIG_HTTPD_MAX_REQ_HDR_LEN=1024
CONFIG_HTTPD_PURGE_BUF_LEN=16


#
# Power Management
#
CONFIG_PM_ENABLE=y


#
# ESP PSRAM
#
CONFIG_SPIRAM=y


#
# Event
#
CONFIG_ESP_SYSTEM_EVENT_TASK_STACK_SIZE=4864
CONFIG_ESP_MAIN_TASK_STACK_SIZE=8192


#
# Watchdog
#
CONFIG_ESP_INT_WDT=y
CONFIG_ESP_INT_WDT_TIMEOUT_MS=2000
CONFIG_ESP_TASK_WDT_EN=n
CONFIG_ESP_TASK_WDT_INIT=n


#
# Wi-Fi
#
CONFIG_ESP32_WIFI_DYNAMIC_RX_BUFFER_NUM=16
CONFIG_ESP32_WIFI_CACHE_TX_BUFFER_NUM=16

#only necessary for WIFI mesh roaming (include/defines.h -> WLAN_USE_MESH_ROAMING)
#CONFIG_WPA_11KV_SUPPORT=y
#CONFIG_WPA_SCAN_CACHE=n
#CONFIG_WPA_MBO_SUPPORT=n
#CONFIG_WPA_11R_SUPPORT=n // Will be supported with ESP-IDF v5.0
#CONFIG_WPA_DEBUG_PRINT=n

# If ENABLE_SOFTAP = disabled, set this to "n" to save 28k of flash
CONFIG_ESP_WIFI_SOFTAP_SUPPORT=y


#
# PHY
#
CONFIG_ESP_PHY_CALIBRATION_AND_DATA_STORAGE=n
CONFIG_ESP_PHY_RF_CAL_FULL=y


#
# FAT Filesystem support
#
CONFIG_FATFS_LFN_HEAP=y
CONFIG_FATFS_MAX_LFN=255
CONFIG_FATFS_API_ENCODING_ANSI_OEM=y


#
# FreeRTOS
#
CONFIG_FREERTOS_PLACE_FUNCTIONS_INTO_FLASH=n
CONFIG_FREERTOS_PLACE_SNAPSHOT_FUNS_INTO_FLASH=n
CONFIG_FREERTOS_ENABLE_TASK_SNAPSHOT=n
CONFIG_FREERTOS_ASSERT_DISABLE=y

#only necessary for task analysis (include/defines.h -> TASK_ANALYSIS_ON)
#set in [env:esp32cam-dev-task-analysis]
#CONFIG_FREERTOS_USE_TRACE_FACILITY=1
#CONFIG_FREERTOS_GENERATE_RUN_TIME_STATS=y
#CONFIG_FREERTOS_VTASKLIST_INCLUDE_COREID=y


#
# Hardware Abstraction Layer (HAL) and Low Level (LL)
#
CONFIG_HAL_ASSERTION_EQUALS_SYSTEM=y


#
# Log output
#
CONFIG_LOG_DEFAULT_LEVEL_INFO=y
CONFIG_LOG_MAXIMUM_EQUALS_DEFAULT=y
CONFIG_LOG_COLORS=n


#
# LWIP
#
CONFIG_LWIP_IPV6=n
CONFIG_LWIP_ESP_LWIP_ASSERT=n


#
# DHCP server
#
CONFIG_LWIP_DHCPS=y


#
# ESP-MQTT Configurations
#
CONFIG_MQTT_MSG_ID_INCREMENTAL=y
CONFIG_MQTT_SKIP_PUBLISH_IF_DISCONNECTED=y
CONFIG_MQTT_TASK_CORE_SELECTION_ENABLED=y
CONFIG_MQTT_USE_CORE_0=y
CONFIG_MQTT_USE_CUSTOM_CONFIG=y


#
# Newlib
#
CONFIG_NEWLIB_NANO_FORMAT=y


#
# Camera configuration
#
CONFIG_OV7670_SUPPORT=n
CONFIG_OV7725_SUPPORT=n
CONFIG_NT99141_SUPPORT=n
CONFIG_OV3660_SUPPORT=n
CONFIG_OV5640_SUPPORT=n
CONFIG_GC2145_SUPPORT=n
CONFIG_GC032A_SUPPORT=n
CONFIG_GC0308_SUPPORT=n
CONFIG_BF3005_SUPPORT=n
CONFIG_BF20A6_SUPPORT=n
CONFIG_SC030IOT_SUPPORT=n
CONFIG_CAMERA_CORE0=n
CONFIG_CAMERA_CORE1=y
CONFIG_CAMERA_DMA_BUFFER_SIZE_MAX=32768
```
